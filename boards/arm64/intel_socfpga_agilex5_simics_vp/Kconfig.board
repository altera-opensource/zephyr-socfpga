## boards/arm64/intel_socfpga_agilex5_simics_vp/Kconfig.board
```kconfig
# Copyright (c) 2023 Intel Corporation
# SPDX-License-Identifier: Apache-2.0

config BOARD_INTEL_SOCFPGA_AGILEX5_SIMICS_VP
	bool "Intel SoC FPGA Agilex5 Simics Virtual Platform Universal"
	depends on SOC_AGILEX5
```

## drivers/watchdog/Kconfig.snps_designware
```kconfig
# Synopsys DesignWare Watchdog Timer configuration option

# Copyright (c) 2022-2023 Intel Corporation

# SPDX-License-Identifier: Apache-2.0

config WDT_SNPS_DESIGNWARE
	bool "Synopsys DesignWare Watchdog (WDT) Driver"
	default y
	depends on DT_HAS_SNPS_DESIGNWARE_WATCHDOG_ENABLED
	help
	  Enable SNPS Designware Watchdog driver.
```

## dts/bindings/cpu/niosv.yaml
```yaml
# Copyright (C) 2022, Intel Corporation
# SPDX-License-Identifier: Apache-2.0

description: INTEL FPGA NIOSV Softcore Processor

compatible: "niosv"

include: cpu.yaml
```

## dts/bindings/watchdog/snps,designware-watchdog.yaml
```yaml
# Copyright (c) 2022-2023 Intel Corporation

# SPDX-License-Identifier: Apache-2.0

description: Synopsys Designware Watchdog timer

compatible: "snps,designware-watchdog"

include: [base.yaml, reset-device.yaml]

properties:
    reg:
      required: true

    clock-frequency:
      type: int
      required: false
      description: clock frequency information for Watchdog Timer
```

## samples/boards/intel_socfpga/intel_socfpga_agilex5_socdk/watchdog/sample.yaml
```yaml
sample:
  description: Watchdog Driver sample application for Intel SoC FPGA Agilex5 boards.
  name: Watchdog
common:
    tags: drivers watchdog
    integration_platforms:
      - intel_socfpga_agilex5_socdk
    harness: console
    harness_config:
        type: multi_line
        ordered: true
        regex:
            - "Watchdog test sample"
            - "Interrupt triggered for watchdog@10d00200"
            - "Interrupt triggered for watchdog@10d00300"
            - "Feeding watchdogs..."
            - "Disabled interrupt based watchdogs"
            - "Waiting for reset..."
            - "Watchdog test sample"
    filter: dt_compat_enabled("snps,designware-watchdog")
    depends_on: watchdog
```

## soc/riscv/riscv-privilege/niosv/Kconfig.defconfig.series
```kconfig
# Copyright (C) 2022, Intel Corporation
# SPDX-License-Identifier: Apache-2.0

if SOC_SERIES_NIOSV

config SOC_SERIES
	default "niosv"

config SYS_CLOCK_HW_CYCLES_PER_SEC
	default $(dt_node_int_prop_int,/cpus/cpu@0,clock-frequency)

config NUM_IRQS
	default 32
	help
	  NIOSV support 32 IRQs, however only 16 IRQs can used for platform interrupts.
	  Platform interrupts IRQs index start from index 16.

config RISCV_HAS_CPU_IDLE
	default y

config RISCV_GP
	default y

config RISCV_SOC_INTERRUPT_INIT
	default y

endif # SOC_SERIES_NIOSV
```

## subsys/sip_svc/Kconfig
```kconfig
# Arm SiP service configuration options

# Copyright (c) 2022, Intel Corporation. All rights reserved.
# SPDX-License-Identifier: Apache-2.0

menuconfig ARM_SIP_SVC_ARM64
	bool "Support for the Arm SiP"
	depends on ARM64
	depends on HAS_ARM_SMCCC
	help
	  Enable Zephyr to communicate with secure system firmware
	  implementing the platform-specifics via Arm SMC.

if ARM_SIP_SVC_ARM64

module = ARM_SIP_SVC_ARM64
module-str = arm_sip_svc

config ARM_SIP_SVC_HAS_HVC_CALLS
	bool "Enables HVC calls to EL2 layer"
	default n
	depends on ARM_SIP_SVC_ARM64

config ARM_SIP_SVC_HAS_SMC_CALLS
	bool "Enables SMC calls to EL3 layer"
	default n
	depends on ARM_SIP_SVC_ARM64

config ARM_SIP_SVC_INIT_PRIORITY
	int "Arm SiP service init function priority"
	default 0
	depends on ARM_SIP_SVC_ARM64

config ARM_SIP_SVC_THREAD_STACK_SIZE
	int "Arm SiP service thread stack size"
	default 1536
	depends on ARM_SIP_SVC_ARM64
	help
	  Stack size of the Arm SiP  service.
	  The thread calls the callbacks of the requestor
	  when operation done.

config ARM_SIP_SVC_THREAD_PRIORITY
	int "Arm SiP service thread priority"
	default 2
	depends on ARM_SIP_SVC_ARM64
	help
	  Priority of the Arm SiP  service.
	  The thread calls the callbacks of the requestor
	  when operation done.

config ARM_SIP_SVC_MSGQ_DEPTH
	int "Arm SiP service request message queue depth"
	default 16
	depends on ARM_SIP_SVC_ARM64

config ARM_SIP_SVC_MAX_CLIENT_COUNT
	int "Arm SiP service maximun clients"
	default 8
	depends on ARM_SIP_SVC_ARM64

config ARM_SIP_SVC_MAX_TRANSACTION_COUNT
	int "Arm SiP service transaction id pool size"
	default 64
	depends on ARM_SIP_SVC_ARM64

config ARM_SIP_SVC_MAX_JOB_COUNT
	int "Arm SiP service maximun transactions to secure monitor firmware"
	default 16
	depends on ARM_SIP_SVC_ARM64

config ARM_SIP_SVC_MAX_ASYNC_RESP_SIZE
	int "Arm SiP service maximun asynchronous response size in byte"
	default 4096
	depends on ARM_SIP_SVC_ARM64

config ARM_SIP_SVC_SHELL
	bool "Arm SiP SVC service shell"
	default y
	depends on ARM_SIP_SVC_ARM64
	depends on ARM_SIP_SVC_HAS_HVC_CALLS || ARM_SIP_SVC_HAS_SMC_CALLS
	depends on SHELL
	help
	  Enable Arm SiP SVC service shell support to communicate with EL3/EL2
	  layers using SMC/HVC calls.

config ARM_SIP_SVC_MAILBOX_CLIENT_SHELL
	bool "Arm SiP Mailbox client shell."
	depends on ARM_SIP_SVC_ARM64
	depends on ARM_SIP_SVC_HAS_SMC_CALLS
	depends on SHELL
	help
	  Enable Arm SiP shell support for communicating with
	  SDM in Intel agilex SoC using ARM Sip SVC service.

endif
```
